## boards/KConfig
```kconfig
menu "Platform configuration"

choice
    prompt "Architecture: "
    default ARCH_STM32F1

    config X86_64_STUB
    bool "X86_64 (emulated)"
    help
        Enable support for X86_64 compilation, but to be executed in simulated environment.
        This is not implemented yet.

    config ARCH_STM32F1
    bool "STM32F1xx"
    help
        Enable support for ST STM32F1xx family.

endchoice

choice

    prompt "Board Selection: "

    config STM32_Black_Pill
        bool "STM32_Black_Pill"
        depends on ARCH_STM32F1
    config NUCLEO-F103RB
        bool "NUCLEO-F103RB"
        depends on ARCH_STM32F1
endchoice

if STM32_Black_Pill

source "boards/Stm32_Black_Pill/KConfig"

endif

endmenu
```

## boards/Kconfig
```kconfig
# This file is part of MSOS project. This is simple OS for embedded development devices.
# Copyright (C) 2019 Mateusz Stadnik
#
# This program is free software: you can redistribute it and/or modify
# it under the terms of the GNU General Public License as published by
# the Free Software Foundation, either version 3 of the License, or
# (at your option) any later version.
#
# This program is distributed in the hope that it will be useful,
# but WITHOUT ANY WARRANTY; without even the implied warranty of
# MERCHANTABILITY or FITNESS FOR A PARTICULAR PURPOSE.  See the
# GNU General Public License for more details.
#
# You should have received a copy of the GNU General Public License
# along with this program.  If not, see <https://www.gnu.org/licenses/>.

menu "Platform configuration"

choice
    prompt "Architecture: "
    default ARCH_STM32F1

    config X86_64_STUB
    bool "X86_64 (emulated)"
    help
        Enable support for X86_64 compilation, but to be executed in simulated environment.
        This is not implemented yet.

    config ARCH_STM32F1
    bool "STM32F1xx"
    help
        Enable support for ST STM32F1xx family.

endchoice

choice
    prompt "Board Selection: "

    config STM32_Black_Pill
        bool "STM32_Black_Pill"
        depends on ARCH_STM32F1
    config NUCLEO-F103RB
        bool "NUCLEO-F103RB"
        depends on ARCH_STM32F1
endchoice

if STM32_Black_Pill
    source "boards/Stm32_Black_Pill/Kconfig"
endif

endmenu
```
